VERSION ""

NS_ :

BS_:
BU_:
BO_ 1680 sent_message: 2 Vector__XXX
   SG_ analog_reading : 7|16@0+ (1,0) [0|1023] "" Vector__XXX

BO_ 1056 request_message: 1 Vector__XXX
   SG_ request_byte : 7|1@0+ (1,0) [0|1] "" Vector__XXX

BA_DEF_ BO_ "GenMsgBackgroundColor" STRING ;
BA_DEF_ BO_ "GenMsgForegroundColor" STRING ;
BA_DEF_ BO_ "filterlabeling" INT 0 0;
BA_ "GenMsgBackgroundColor" BO_ 1680 "#aaffff";
BA_ "GenMsgBackgroundColor" BO_ 1056 "#ffff7f";
BA_DEF_DEF_ "GenMsgBackgroundColor" "#ffffff";
BA_DEF_DEF_ "GenMsgForegroundColor" "#000000";
BA_DEF_DEF_ "filterlabeling" 1;
VAL_ 1056 request_byte 0 "Request_sent";
